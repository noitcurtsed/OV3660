## main/Kconfig.projbuild
```kconfig
menu "Example Configuration"

    choice EXAMPLE_CAMERA_SENSOR_MODEL
        prompt "Camera sensor model (DVP)"
        default EXAMPLE_CAMERA_SENSOR_OV3660
        depends on SOC_LCDCAM_CAM_SUPPORTED
        help
            Chooses which sensor driver is built into the firmware and registered for SCCB/DVP auto-detection.
            Enable exactly one sensor here; do not enable the other sensor under "Espressif Camera Sensors Configurations"
            or both drivers may probe the bus.

        config EXAMPLE_CAMERA_SENSOR_OV3660
            bool "OV3660"
            select CAMERA_OV3660
            select CAMERA_OV3660_AUTO_DETECT_DVP_INTERFACE_SENSOR

        config EXAMPLE_CAMERA_SENSOR_OV5640
            bool "OV5640"
            select CAMERA_OV5640
            select CAMERA_OV5640_AUTO_DETECT_DVP_INTERFACE_SENSOR
    endchoice

    config EXAMPLE_ENABLE_LCD
        bool "Enable SPI LCD output (ST7789 on ESP32-S3-EYE sub-board)"
        default n
        help
            Disable this if your kit has no LCD, a different controller, or different wiring.
            The camera pipeline still runs; frames are not drawn.

    menu "OV5640 display tuning"
        depends on EXAMPLE_CAMERA_SENSOR_OV5640 && EXAMPLE_ENABLE_LCD

        config EXAMPLE_OV5640_LCD_SWAP_XY
            bool "Swap LCD panel X/Y for QVGA (320x240)"
            default y
            help
                Portrait ST7789 boards are often 240x320 physical pixels while OV5640 QVGA is 320x240.
                Drawing without swapping axes overflows the shorter dimension and often looks like missing
                or alternating wrong rows. Disable if your panel is already mounted landscape.

        config EXAMPLE_OV5640_SENSOR_PIXEL_SWAP
            bool "OV5640 pixel byte swap (Espressif CAM sensor option)"
            default y
            select CAMERA_SENSOR_SWAP_PIXEL_BYTE_ORDER
            help
                Enables pixel byte order swapping under Espressif Camera Sensors (OV5640 is in the supported list).
                Often fixes striped / every-other-line chroma artifacts with YUV422 and RGB565 endian mismatches on DVP.

        config EXAMPLE_OV5640_LCD_BGR565
            bool "ST7789 RGB element order BGR565 (fixes yellow/purple cast)"
            default y
            help
                Many SPI ST7789 paths expect 16-bit pixels as BGR565. If red and blue look swapped (e.g. sky purple,
                skin yellow), keep this on. Disable if whites look correct only with classic RGB565 labelling.
    endmenu

    choice EXAMPLE_CAM_HRES
        bool "Set camera horizontal resolution"
        depends on EXAMPLE_CAMERA_SENSOR_OV3660
        default EXAMPLE_CAM_HRES_240

        config EXAMPLE_CAM_HRES_640
            bool "640"
        config EXAMPLE_CAM_HRES_240
            bool "240"
    endchoice

    config EXAMPLE_CAM_HRES
        int
        default 320 if EXAMPLE_CAMERA_SENSOR_OV5640
        default 640 if EXAMPLE_CAM_HRES_640
        default 240 if EXAMPLE_CAM_HRES_240

    choice EXAMPLE_CAM_VRES
        bool "Set camera vertical resolution"
        depends on EXAMPLE_CAMERA_SENSOR_OV3660
        default EXAMPLE_CAM_VRES_480 if EXAMPLE_CAM_HRES_640
        default EXAMPLE_CAM_VRES_240 if EXAMPLE_CAM_HRES_240

        config EXAMPLE_CAM_VRES_480
            bool "480"
        config EXAMPLE_CAM_VRES_240
            bool "240"
    endchoice

    config EXAMPLE_CAM_VRES
        int
        default 240 if EXAMPLE_CAMERA_SENSOR_OV5640
        default 480 if EXAMPLE_CAM_VRES_480
        default 240 if EXAMPLE_CAM_VRES_240

    comment "OV5640 DVP uses fixed QVGA 320x240 in firmware (matches LCD frame buffer size better than SVGA)."
    depends on EXAMPLE_CAMERA_SENSOR_OV5640

    choice EXAMPLE_CAM_INPUT_FORMAT
        bool "Set camera input format"
        default EXAMPLE_CAM_INPUT_FORMAT_YUV422

        config EXAMPLE_CAM_INPUT_FORMAT_RGB565
            bool "RGB565"
        config EXAMPLE_CAM_INPUT_FORMAT_YUV422
            bool "YUV422"
    endchoice

    config EXAMPLE_CAM_SCCB_SDA_GPIO
        int "Camera SCCB SDA (SIOD) GPIO"
        range 0 48
        default 4
        help
            Espressif ESP32-S3-EYE default is GPIO 4 (same camera SCCB bus as BSP_I2C_SDA).
            Change only if your PCB differs.

    config EXAMPLE_CAM_SCCB_SCL_GPIO
        int "Camera SCCB SCL (SIOC) GPIO"
        range 0 48
        default 5
        help
            Espressif ESP32-S3-EYE default is GPIO 5 (same as BSP_I2C_SCL).

    config EXAMPLE_CAM_XCLK_SETTLE_MS
        int "Delay after DVP starts XCLK before SCCB probe (ms)"
        range 0 500
        default 150
        help
            Sensors need stable MCLK before ID registers respond on SCCB. Increase if you see NACK / Get sensor ID failed.

    config EXAMPLE_CAM_SCCB_FREQ_KHZ
        int "Camera SCCB / I2C clock frequency (kHz)"
        range 10 400
        default 40
        help
            Try 10 if the bus misbehaves at higher speeds; try up to 100 if probing is stable.

    config EXAMPLE_CAM_I2C_PULLUP_INTERNAL
        bool "Enable internal pull-ups on SCCB SDA/SCL"
        default y
        help
            Disable only if your PCB already has external pull-ups (avoid weak dual pull-ups).

    config EXAMPLE_CAM_I2C_PROBE
        bool "Log I2C probe for common camera addresses (0x30,0x36,0x3c,0x3d,...)"
        default n
        help
            Prints which addresses ACK before sensor detection. OV3660/OV5640 often use 0x3c; OV3660 may use 0x3d if SID strapped.

endmenu
```

## sdkconfig.defaults
```kconfig
# CONFIG_EXAMPLE_ENABLE_LCD is not set

# CONFIG_CAMERA_OV2640 is not set
CONFIG_EXAMPLE_CAMERA_SENSOR_OV3660=y
CONFIG_CAMERA_OV3660=y
CONFIG_CAMERA_OV3660_AUTO_DETECT_DVP_INTERFACE_SENSOR=y
CONFIG_CAMERA_OV3660_DVP_YUV422_240X240_24FPS=y
CONFIG_CAMERA_OV3660_DVP_IF_FORMAT_INDEX_DEFAULT=1

CONFIG_EXAMPLE_CAM_SCCB_SDA_GPIO=4
CONFIG_EXAMPLE_CAM_SCCB_SCL_GPIO=5

CONFIG_EXAMPLE_CAM_XCLK_SETTLE_MS=150
CONFIG_EXAMPLE_CAM_SCCB_FREQ_KHZ=40
CONFIG_EXAMPLE_CAM_I2C_PULLUP_INTERNAL=y
CONFIG_EXAMPLE_CAM_I2C_PROBE=y

# --- OV5640 example (uncomment and comment out OV3660 lines above after fresh sdkconfig) ---
# CONFIG_EXAMPLE_CAMERA_SENSOR_OV3660 is not set
# CONFIG_CAMERA_OV3660 is not set
# CONFIG_EXAMPLE_CAMERA_SENSOR_OV5640=y
# CONFIG_CAMERA_OV5640=y
# CONFIG_CAMERA_OV5640_AUTO_DETECT_DVP_INTERFACE_SENSOR=y
```
